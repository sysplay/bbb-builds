## Yocto/meta-sysplay/conf/layer.conf
```bitbake
# We have a conf and classes directory, add to BBPATH
BBPATH .= ":${LAYERDIR}"

# We have recipes-* directories, add to BBFILES
BBFILES += "${LAYERDIR}/recipes-*/*/*.bb \
            ${LAYERDIR}/recipes-*/*/*.bbappend"

BBFILE_COLLECTIONS += "meta-sysplay"
BBFILE_PATTERN_meta-sysplay = "^${LAYERDIR}/"
BBFILE_PRIORITY_meta-sysplay = "6"

LAYERDEPENDS_meta-sysplay = "core"
LAYERSERIES_COMPAT_meta-sysplay = "kirkstone"
```
